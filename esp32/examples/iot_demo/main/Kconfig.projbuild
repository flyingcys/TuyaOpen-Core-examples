## esp32/examples/iot_demo/main/Kconfig.projbuild
```kconfig
menu "iot_demo"

    config ENABLE_QRCODE
        bool "ENABLE_QRCODE: QR code output for Tuya APP binding"
        default y
        help
            编译 qrcode 模块（qrcodegen + qrencode_print，与 linux iot_demo
            的 qrcode/ 子目录同源）并启用 demo 里的二维码打印（扫码激活）。
            qrcode 不在 core 内（随应用走），故由本菜单定义；映射到 CMake
            开关 CONFIG_ENABLE_QRCODE，core 侧宏注入为 ENABLE_QRCODE。

    config DEMO_WIFI_SSID
        string "WiFi SSID (station)"
        default ""
        help
            demo 要连接的 WiFi 名称（station 模式）。
            core 已无 wifi 抽象，"把 WiFi 连上"由 demo 层完成：连上后网络栈
            就绪，后续流程与 linux 一致（port 的 tkl_netif 上报链路状态）。

    config DEMO_WIFI_PASSWORD
        string "WiFi password"
        default ""
        help
            WiFi 密码（开放网络留空）。

endmenu
```

## linux/examples/p2p_demo/Kconfig
```kconfig
menu "configure app (p2p_demo)"

    config P2P_DEMO
        bool
        default y
        select ENABLE_TUYA_P2P
        select ENABLE_IPC_RING_BUFFER
        help
            构建 linux/examples/p2p_demo（虚拟摄像头视频源 + P2P 直播）。
            默认 y：p2p_demo 是独立 CMake 工程，本开关只负责把 P2P 链路
            依赖的 core 开关（ENABLE_TUYA_P2P / ENABLE_IPC_RING_BUFFER）
            在共享的 .config 里带起来。本符号无 prompt（menuconfig 里不可
            交互关闭），不构建该 example 即可，无需关闭此符号。

    config P2P_DEMO_LOCAL_STORE
        bool "Recording and calendar playback (local_store)"
        depends on P2P_DEMO
        default n
        select ENABLE_LOCAL_STORE
        help
            打开本地录像与日历回放（local_store）。默认 n：live 直播链路
            不依赖它；开启后 demo 会把编码帧写入 ./media 并响应 App 的
            日历查询/回放请求（Linux 上直接写宿主目录，无 SD 卡挂载）。

    config P2P_DEMO_WIDTH
        int "Capture width"
        depends on P2P_DEMO
        default 2304
        help
            上报给 App 的视频宽度（像素），需与视频源文件一致
            （内置 demo_video.264 为 2304x1296），否则 AV 能力上报与实际
            码流不一致。

    config P2P_DEMO_HEIGHT
        int "Capture height"
        depends on P2P_DEMO
        default 1296
        help
            上报给 App 的视频高度（像素），需与视频源文件一致。

    config P2P_DEMO_FPS
        int "Capture fps"
        depends on P2P_DEMO
        default 15
        help
            虚拟摄像头的喂帧帧率（同时也是上报给 App 的 fps）。内置
            demo_video.264 为 15fps，换视频源时要同步改这里。

    config P2P_DEMO_KBPS
        int "Target bitrate (kbps)"
        depends on P2P_DEMO
        default 960
        help
            上报给 App 的目标码率（kbps）。视频源是固定码率文件，源端不
            参与实际码控，此值只影响 AV 能力上报与 App 的清晰度档位选择
            （内置视频约 960kbps）。

    config P2P_DEMO_GOP
        int "GOP length (frames)"
        depends on P2P_DEMO
        default 60
        help
            上报给 App 的 GOP 长度（帧）。内置视频为 60 帧固定 GOP
            （每 4 秒一个 IDR），供 App 估算 I 帧间隔。

    config P2P_DEMO_H264_FILE
        string "Live video source file (empty = bundled demo_video.264)"
        depends on P2P_DEMO
        default ""
        help
            直播视频源文件路径。留空用内置视频（构建目录的
            demo_video.264，由 assets/demo_video.264 复制而来，源自上游
            camera_demo 的 demo_video.264）；填写则用该 Annex-B H.264
            文件（AU 边界按 AUD 或 VCL 切分，无 AUD 亦可）。

    config P2P_DEMO_LIVE_RECORD
        bool "Live H264 record to local_store"
        depends on P2P_DEMO_LOCAL_STORE
        default n
        help
            直播期间把编码帧持续写入 local_store（默认 n：只在 App 主动
            回放时读已录内容）。开启后按 P2P_DEMO_RECORD_MAX_SEC 分段。

    config P2P_DEMO_RECORD_MAX_SEC
        int "Max seconds per recording segment"
        depends on P2P_DEMO_LIVE_RECORD
        default 120
        range 30 3600
        help
            单个录像分段的时长上限（秒），到时切下一个分段文件。
            默认 120 秒，范围 30-3600。

    config P2P_DEMO_PB_SEED
        bool "Boot-time playback seed from the live source file"
        depends on P2P_DEMO_LOCAL_STORE
        default n
        help
            启动时把直播源文件灌进当天的 local_store 索引，让 App 不录像
            也能直接体验日历回放（对应上游的 CAMERA_DEMO_PB_SEED）。
            默认 n：正常路径由录像产生可回放内容。

endmenu
```
